/*
 * Copyright (c) 2021 Rafael Yumagulov
 *
 * SPDX-License-Identifier: MIT
 */

#include "dao.dtsi"

&default_transform {
	col-offset = <6>;
};

&kscan0 {
    diode-direction = "col2row";
	col-gpios
		= <&gpio0 12 (GPIO_ACTIVE_HIGH | GPIO_PULL_UP)>
		, <&gpio1  9 (GPIO_ACTIVE_HIGH | GPIO_PULL_UP)>
		, <&gpio0  8 (GPIO_ACTIVE_HIGH | GPIO_PULL_UP)>
		, <&gpio0 13 (GPIO_ACTIVE_HIGH | GPIO_PULL_UP)>
		, <&gpio0 15 (GPIO_ACTIVE_HIGH | GPIO_PULL_UP)>
		, <&gpio0 20 (GPIO_ACTIVE_HIGH | GPIO_PULL_UP)>
		;
    row-gpios
        = <&gpio0  6 (GPIO_ACTIVE_HIGH | GPIO_PULL_DOWN)>
        , <&gpio0  4 (GPIO_ACTIVE_HIGH | GPIO_PULL_DOWN)>
        , <&gpio0 22 (GPIO_ACTIVE_HIGH | GPIO_PULL_DOWN)>
        , <&gpio0 24 (GPIO_ACTIVE_HIGH | GPIO_PULL_DOWN)>
        ;
};
